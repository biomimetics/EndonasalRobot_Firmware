&i2c1 {
    status = "okay";
    clock-frequency = <I2C_BITRATE_STANDARD>;
    pinctrl-0 = <&i2c1_scl_pb8 &i2c1_sda_pb9>;
    pinctrl-names = "default";
};

&i2c2 {
    status = "okay";
    clock-frequency = <I2C_BITRATE_STANDARD>;
    pinctrl-0 = <&i2c2_scl_pb10 &i2c2_sda_pb3>;
    pinctrl-names = "default";
};

/* Console / Python link on the ST-Link virtual COM port, same rate as ZephyrEndoCode */
&usart2 {
    current-speed = <230400>;
};
